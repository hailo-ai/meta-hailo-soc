## meta-hailo-bsp-examples/conf/layer.conf
```bitbake
# We have a conf and classes directory, add to BBPATH
BBPATH .= ":${LAYERDIR}"

# We have recipes-* directories, add to BBFILES
BBFILES += "${LAYERDIR}/*/recipes-*/*/*.bb \
            ${LAYERDIR}/*/recipes-*/*/*.bbappend"

BBFILE_COLLECTIONS += "meta-hailo-bsp-examples"
BBFILE_PATTERN_meta-hailo-bsp-examples = "^${LAYERDIR}/"
BBFILE_PRIORITY_meta-hailo-bsp-examples = "7"

LAYERDEPENDS_meta-hailo-bsp-examples = "core meta-hailo-bsp"
LAYERSERIES_COMPAT_meta-hailo-bsp-examples = "kirkstone"

IMAGE_BOOT_FILES += "swupdate-image-${MACHINE}.ext4.gz"
WKS_FILE_DEPENDS += "swupdate-image"

CORE_IMAGE_EXTRA_INSTALL += " hailo-dma-memcopy"
```

## meta-hailo-bsp/conf/layer.conf
```bitbake
# We have a conf and classes directory, add to BBPATH
BBPATH .= ":${LAYERDIR}"

# We have recipes-* directories, add to BBFILES
BBFILES += "${LAYERDIR}/recipes-*/*/*.bb \
            ${LAYERDIR}/recipes-*/*/*.bbappend"

BBFILE_COLLECTIONS += "meta-hailo-bsp"
BBFILE_PATTERN_meta-hailo-bsp = "^${LAYERDIR}/"
BBFILE_PRIORITY_meta-hailo-bsp = "6"

LAYERDEPENDS_meta-hailo-bsp = " \
    core \
    meta-arm \
"

LAYERSERIES_COMPAT_meta-hailo-bsp = "kirkstone"

IMAGE_ROOTFS_EXTRA_SPACE = "262144"

CORE_IMAGE_EXTRA_INSTALL:append = " recovery-fw scu-fw"
```

## meta-hailo-bsp/conf/machine/hailo15-evb-security-camera.conf
```bitbake
require hailo15-evb.inc

UBOOT_MACHINE = "hailo15_evb_security_camera_defconfig"
```

## meta-hailo-bsp/conf/machine/hailo15-ginger-soc.conf
```bitbake
require hailo15-base.inc

SDIO0_POSTFIX = "${@bb.utils.contains('MACHINE_FEATURES', 'sdio0', '_sdio0', '', d)}"
UBOOT_MACHINE = "hailo15_ginger_soc${SDIO0_POSTFIX}_defconfig"
```

## meta-hailo-bsp/conf/machine/hailo15-veloce.conf
```bitbake
require hailo15-base.inc

UBOOT_MACHINE = "hailo15_veloce_defconfig"
FIT_KERNEL_COMP_ALG = "none"
FIT_KERNEL_COMP_ALG_EXTENSION = ""

# disable SSH in veloce since it causes key generation at boot time which slows down the boot
EXTRA_IMAGE_FEATURES:remove = "${SSH_SERVER_FEATURES}"
```

## meta-hailo-bsp/recipes-bsp/u-boot-tfa-image/files/u-boot-tfa.its
```
/dts-v1/;

/ {
	description = "U-Boot & Trusted firmware bundle";

	images {
		atf {
			description = "ARM TrustedFirmware-A";
			data = /incbin/("bl31.bin");
			type = "firmware";
			os = "arm-trusted-firmware";
			arch = "arm64";
			compression = "none";
			load = <0x80000000>;
			entry = <0x80000000>;
			hash-1 {
					algo = "sha256";
			};
		};
		uboot {
			description = "U-Boot";
			data = /incbin/("u-boot-nodtb.bin");
			type = "firmware";
			os = "u-boot";
			arch = "arm64";
			compression = "none";
			load = <0x83000000>;
			entry = <0x83000000>;
			hash-1 {
					algo = "sha256";
			};
		};
	};
	configurations {
		default = "config_1";

		config_1 {
			description = "H15-uboot-atf";
			firmware = "atf";
			loadables = "uboot";
			atf = "atf";
			uboot = "uboot";
			hash-1 {
					algo = "sha256";
			};
			signature {
				algo = "sha256,rsa3072";
				key-name-hint = "customer";
				sign-images = "atf", "uboot";
			};
		};
	};
};
```

## meta-hailo-bsp/wic/sd.wks
```
# short-description: Create SD card image for Hailo
# long-description: Creates a partitioned SD card image for Hailo.
# Boot files are located in the first vfat partition.

part /boot --source bootimg-partition --ondisk mmcblk0 --fstype=vfat --label boot --active --align 4 --fixed-size 64M --use-uuid
part / --source rootfs --ondisk mmcblk --fstype=ext4 --label root --align 4 --use-uuid
```

## meta-hailo-dsp/conf/layer.conf
```bitbake
# We have a conf and classes directory, add to BBPATH
BBPATH .= ":${LAYERDIR}"

# We have recipes-* directories, add to BBFILES
BBFILES += "${LAYERDIR}/recipes-*/*/*.bb \
            ${LAYERDIR}/recipes-*/*/*.bbappend"

BBFILE_COLLECTIONS += "meta-hailo-dsp"
BBFILE_PATTERN_meta-hailo-dsp = "^${LAYERDIR}/"
BBFILE_PRIORITY_meta-hailo-dsp = "6"

LAYERDEPENDS_meta-hailo-dsp = "core meta-hailo-bsp"
LAYERSERIES_COMPAT_meta-hailo-dsp = "kirkstone"

CORE_IMAGE_EXTRA_INSTALL:append = " libhailodsp-dev dsp-fw"
```

## meta-hailo-imaging/conf/layer.conf
```bitbake
# We have a conf and classes directory, add to BBPATH
BBPATH .= ":${LAYERDIR}"

# We have recipes-* directories, add to BBFILES
BBFILES += "${LAYERDIR}/recipes-*/*/*.bb \
            ${LAYERDIR}/recipes-*/*/*.bbappend"

BBFILE_COLLECTIONS += "meta-hailo-imaging"
BBFILE_PATTERN_meta-hailo-imaging = "^${LAYERDIR}/"
BBFILE_PRIORITY_meta-hailo-imaging = "6"

LAYERDEPENDS_meta-hailo-imaging = "core"
LAYERSERIES_COMPAT_meta-hailo-imaging = "kirkstone"

# For vc8000e encoder
CORE_IMAGE_EXTRA_INSTALL += "video-encoder video-encoder-kernel-modules"
KERNEL_MODULE_AUTOLOAD += "hx280enc"

CORE_IMAGE_EXTRA_INSTALL += "imaging-sub-system"
MACHINE_ESSENTIAL_EXTRA_RDEPENDS += "kernel-module-cdns-csi2rx kernel-module-hailo15-pixel-mux kernel-module-hailo15-rxwrapper kernel-module-hailo15-isp kernel-module-hailo15-video-cap"
MACHINE_ESSENTIAL_EXTRA_RDEPENDS += "${@bb.utils.contains('MACHINE_FEATURES', 'imx334', 'kernel-module-imx334', '', d)}"
MACHINE_ESSENTIAL_EXTRA_RDEPENDS += "${@bb.utils.contains('MACHINE_FEATURES', 'imx678', 'kernel-module-imx678', '', d)}"
MACHINE_ESSENTIAL_EXTRA_RDEPENDS += "kernel-module-hailo15-af-monitor"
```

## meta-hailo-imaging/conf/machine/mercury-ginger-imaging.conf
```bitbake
require conf/machine/hailo15-base.inc

UBOOT_MACHINE = "hailo15_ginger_imaging_defconfig"

CORE_IMAGE_EXTRA_INSTALL += "vision-subsystem imaging-sub-system imaging-sub-system-kernel-modules"

MACHINE_ESSENTIAL_EXTRA_RDEPENDS += "kernel-module-ov2775 kernel-module-cdns-csi2rx kernel-module-hailo15-pixel-mux kernel-module-imx334 kernel-module-hailo15-rxwrapper"
```

## meta-hailo-imaging/conf/machine/mercury-lavender-encoder.conf
```bitbake
require conf/machine/hailo15-base.inc

UBOOT_MACHINE = "hailo15_lavender_encoder_defconfig"

CORE_IMAGE_EXTRA_INSTALL += "imaging-sub-system imaging-sub-system-kernel-modules"
```

## meta-hailo-linux/conf/layer.conf
```bitbake
# We have a conf and classes directory, add to BBPATH
BBPATH .= ":${LAYERDIR}"

# We have recipes-* directories, add to BBFILES
BBFILES += "${LAYERDIR}/recipes-*/*/*.bb \
            ${LAYERDIR}/recipes-*/*/*.bbappend"

BBFILE_COLLECTIONS += "meta-hailo-linux"
BBFILE_PATTERN_meta-hailo-linux = "^${LAYERDIR}/"
BBFILE_PRIORITY_meta-hailo-linux = "6"

LAYERDEPENDS_meta-hailo-linux = "core"
LAYERSERIES_COMPAT_meta-hailo-linux = "kirkstone"

# _x11 
DISTRO_FEATURES:append = " x11 pam" 

PREFERRED_VERSION_gstreamer1.0 = "1.20.2"
PREFERRED_VERSION_gstreamer1.0-plugins-base = "1.20.2"
# Adding gstreamer to image only if env var ADD_GSTREAMER_TO_IMAGE is set to "true"
GSTREAMER_VERSIONS = " gstreamer1.0 gstreamer1.0-plugins-base gstreamer1.0-plugins-good gstreamer1.0-plugins-bad gstreamer1.0-rtsp-server"
FD_MAX_OPEN_FILES ?= "2048"

# Adding default user/password
INHERIT += "extrausers"
PASSWD = "\$5\$5bZLqb1IqC\$WqgDM7KNoNcQF4IUwvYWZG15NXQ6tTpvbBvyq.4BQZ3"
EXTRA_USERS_PARAMS = "usermod -p '${PASSWD}' root;"
```

## meta-hailo-media-library/conf/layer.conf
```bitbake
# We have a conf and classes directory, add to BBPATH
BBPATH .= ":${LAYERDIR}"

# We have recipes-* directories, add to BBFILES
BBFILES += "${LAYERDIR}/recipes-*/*/*.bb \
            ${LAYERDIR}/recipes-*/*/*.bbappend"

BBFILE_COLLECTIONS += "meta-hailo-media-library"
BBFILE_PATTERN_meta-hailo-media-library = "^${LAYERDIR}/"
BBFILE_PRIORITY_meta-hailo-media-library = "8"

LAYERDEPENDS_meta-hailo-media-library = "core"
LAYERSERIES_COMPAT_meta-hailo-media-library = "kirkstone"

TOOLCHAIN_TARGET_TASK:append = " expected"
```
