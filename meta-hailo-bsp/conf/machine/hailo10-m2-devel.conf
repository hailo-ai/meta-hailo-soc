## meta-hailo-bsp/conf/machine/hailo10-m2-devel.conf
```bitbake
require hailo10-m2.conf

UBOOT_MACHINE = "hailo10_m2_devel_defconfig"

UBOOT_DTBS = ""
```

## meta-hailo-bsp/conf/machine/hailo10-m2.conf
```bitbake
MACHINEOVERRIDES =. "hailo10-m2:"

require include/hailo10-base.inc
require include/hailo15-base.inc
require include/hailo-accelerator-base.inc

UBOOT_MACHINE = "hailo10_m2_defconfig"

UBOOT_DTBS = " \
    hailo10-board-sku-0.dtb \
    hailo10-board-sku-1.dtb \
    hailo10-board-sku-3.dtb \
    hailo10-board-sku-4.dtb \
    hailo10-board-sku-5.dtb \
    hailo10-board-sku-6.dtb \
    hailo10-board-sku-9.dtb \
    hailo10-board-sku-10.dtb \
    hailo10-board-sku-11.dtb \
    hailo10-board-sku-12.dtb \
    hailo10-board-sku-13.dtb \
    hailo10-board-sku-14.dtb \
"

FIT_KERNEL_COMP_ALG="none"

MACHINE_FEATURES += "falcon_mode"
```

## meta-hailo-bsp/conf/machine/hailo10h2-maple.conf
```bitbake
require include/hailo10h2-base.inc

SCU_FW_MACHINE = "maple"
SCU_BL_MACHINE = "maple"
RECOVERY_FW_MACHINE = "maple"

UBOOT_MACHINE = "hailo10h2_maple_defconfig"
```

## meta-hailo-bsp/conf/machine/hailo10h2-mint.conf
```bitbake
require include/hailo10h2-base.inc

SCU_FW_MACHINE = "mint"
SCU_BL_MACHINE = "mint"
RECOVERY_FW_MACHINE = "mint"

UBOOT_MACHINE = "hailo10h2_mint_defconfig"
```

## meta-hailo-bsp/conf/machine/hailo10h2-veloce.conf
```bitbake
require include/hailo10h2-base.inc
require include/veloce.inc

SCU_FW_MACHINE = "hailo10h2_veloce"
SCU_BL_MACHINE = "hailo10h2_veloce"
RECOVERY_FW_MACHINE = "hailo10h2_veloce"

UBOOT_MACHINE = "hailo10h2_veloce_defconfig"
```

## meta-hailo-bsp/conf/machine/hailo12l-evb.conf
```bitbake
require include/hailo12l-base.inc

SCU_FW_MACHINE = "hailo12l"
SCU_BL_MACHINE = "hailo12l"
RECOVERY_FW_MACHINE = "hailo12l"

UBOOT_MACHINE = "hailo12l_evb_defconfig"
```

## meta-hailo-bsp/conf/machine/hailo12l-maple.conf
```bitbake
require include/hailo12l-base.inc

SCU_FW_MACHINE = "maple"
SCU_BL_MACHINE = "maple"
RECOVERY_FW_MACHINE = "maple"

UBOOT_MACHINE = "hailo12l_maple_defconfig"
```

## meta-hailo-bsp/conf/machine/hailo12l-mint.conf
```bitbake
require include/hailo12l-base.inc

SCU_FW_MACHINE = "mint"
SCU_BL_MACHINE = "mint"
RECOVERY_FW_MACHINE = "mint"

UBOOT_MACHINE = "hailo12l_mint_defconfig"
```

## meta-hailo-bsp/conf/machine/hailo12l-veloce.conf
```bitbake
require include/hailo12l-base.inc
require include/veloce.inc

SCU_FW_MACHINE = "hailo12l_veloce"
SCU_BL_MACHINE = "hailo12l_veloce"
RECOVERY_FW_MACHINE = "hailo12l_veloce"

UBOOT_MACHINE = "hailo12l_veloce_defconfig"
```

## meta-hailo-bsp/conf/machine/hailo15-base.inc
```bitbake
require conf/machine/include/hailo1x-base.inc

HAILO_SOC_NAME ??= "hailo15"
HAILO_HOST_NAME ??= "${HAILO_SOC_NAME}"

HAILO_PLATFORM_NAME = "${@d.getVar('HAILO_SOC_NAME').capitalize()}"
hostname:pn-base-files ??= "${HAILO_HOST_NAME}"

SCU_FW_MACHINE = "${HAILO_SOC_NAME}"
SCU_BL_MACHINE = "${HAILO_SOC_NAME}"
RECOVERY_FW_MACHINE = "${HAILO_SOC_NAME}"
DSP_FW_TARGET = "${HAILO_SOC_NAME}"
```

## meta-hailo-bsp/conf/machine/hailo15-sbc-rev3-1.conf
```bitbake
require include/hailo15-base.inc
require include/hailo-vpu-base.inc

UBOOT_MACHINE = "hailo15_sbc_rev3-1_defconfig"
```

## meta-hailo-bsp/conf/machine/hailo15-sbc-rev3.conf
```bitbake
require include/hailo15-base.inc
require include/hailo-vpu-base.inc

UBOOT_MACHINE = "hailo15_sbc_rev3_defconfig"
```

## meta-hailo-bsp/conf/machine/include/hailo-accelerator-base.inc
```bitbake
require hailo-product-type-base.inc

DISTRO_FEATURES:append = " \
    gen-ai \
    hrt-gen-ai \
    hrt-server \
    pci-server \
    "

DISTROOVERRIDES =. "accelerator:"
```

## meta-hailo-bsp/conf/machine/include/hailo-product-type-base.inc
```bitbake
require hailo-package-manager.inc

# Hailo product type (VPU/Accelerator) base configuration
DISTRO_FEATURES:append = " \
    analysis \
    ddr \
    gpio \
    iio \
    mmc \
    mtd \
    networking \
    pci \
    pkg-manager \
    sensors \
    usb \
    "

EXTRA_IMAGE_FEATURES:append = " \
    allow-root-login \
    package-management \
    "

ENABLE_DISTRO_FEATURES = "True"
```

## meta-hailo-bsp/conf/machine/include/hailo-vpu-base.inc
```bitbake
require hailo-product-type-base.inc

DISTRO_FEATURES:append = " \
    audio \
    display \
    fs \
    kernel-modules \
    video \
    x11 \
    "
DISTROOVERRIDES =. "vpu:"
```

## meta-hailo-bsp/conf/machine/include/hailo10h2-base.inc
```bitbake
HAILO_SOC_NAME = "hailo10h2"
MACHINEOVERRIDES =. "${HAILO_SOC_NAME}:"

require hailo15-base.inc
```

## meta-hailo-bsp/conf/machine/include/hailo12l-base.inc
```bitbake
HAILO_SOC_NAME = "hailo12l"
MACHINEOVERRIDES =. "${HAILO_SOC_NAME}:"

require hailo15-base.inc
require hailo-accelerator-base.inc
```

## meta-hailo-bsp/conf/machine/include/hailo15-base.inc
```bitbake
require conf/machine/include/hailo15-family-base.inc

HAILO_SOC_NAME ??= "hailo15"
HAILO_HOST_NAME ??= "${HAILO_SOC_NAME}"
hostname:pn-base-files = "${HAILO_HOST_NAME}"

SCU_FW_MACHINE = "${HAILO_SOC_NAME}"
SCU_BL_MACHINE = "${HAILO_SOC_NAME}"
RECOVERY_FW_MACHINE = "${HAILO_SOC_NAME}"
DSP_FW_TARGET = "${HAILO_SOC_NAME}"
```

## meta-hailo-bsp/conf/machine/include/hailo15l-base.inc
```bitbake
HAILO_SOC_NAME = "hailo15l"
MACHINEOVERRIDES =. "${HAILO_SOC_NAME}:"

require hailo15-base.inc
```
